// .:::mlc76520:::. 01/01/2025
// sjm4306 C 07/30/21 --- www.youtube.com/@sjm4306 --- https://hackaday.io/project/181004-digital-vu-meter-with-analog-physics ---
//https://en.wikipedia.org/wiki/Bresenham's_line_algorithm

#include <EEPROM.h>
#include <SPI.h>
#include <Wire.h>
#include <AverageValue.h>

#define testbit(data, bitno) ((data >> bitno) & 0x001)  //Byte manipulation macros
#define bit_set(var, bitno) ((var) |= 1 << (bitno))
#define bit_clr(var, bitno) ((var) &= ~(1 << (bitno)))

#define SSD1306 0
#define SSD1309 1
#define SH1106 2

//#define disp_type SH1106
int disp_type = SSD1309;

#define RST 4  //PD4
#define DC 3   //PD3
#define CS0 2  //PD2 Left Display Chip Select
#define CS1 7  //PD7 Right Display Chip Select
#define SCK 13
#define MOSI 11

#define Plus 6   //increase brightness
#define Minus 5  //decrease brightness
#define BTN 8    //Mode select button
#define BTNM 9   //Screen selector Vu or spectrum

//#define LED 13

#define CMD 0
#define DATA 1

//Display in normal or inverted pixels
#define NORM 0
#define INV 1

#define Disp0 0  //Left Display
#define Disp1 1  //Right Display

//I2C
volatile int buffer[9];
int i2c_addr = 0x08;

//spectrumBars
byte audio_bar_heightL[7];  // sizes for the individual bars
byte audio_bar_peakL[7];    // positions for the individual peaks (lines over the bars)
byte audio_bar_heightR[7];  // sizes for the individual bars
byte audio_bar_peakR[7];    // positions for the individual peaks (lines over the bars)

// VuMeter PI
unsigned int cnt = 0;
unsigned int val0 = 0, val1 = 0;
int pos0 = 0, pos1 = 0;
int err_accum0 = 0, err_accum1 = 0;
int err0 = 0, err1 = 0;

//Average level
volatile int levelsR[7];
volatile int levelsL[7];
volatile int averagelevelL = 0;
volatile int averagelevelR = 0;
const long MAX_VALUES_NUM = 7;
AverageValue<long> averageValueL(MAX_VALUES_NUM);
AverageValue<long> averageValueR(MAX_VALUES_NUM);

int SCR = 0;         // To hold on a screen: 0 = Spectrum analyser, 1= VUmeter
int SBT = 0;         // To hold Spectrum Bars Type
byte SLEEP = false;  // screensaver function

char PHYS = 1;  //enable needle mass spring physics response, 0 no physics, 1 underdamped, 2 overdamped
// p  ,i
// 0.2,0.8 - lots of overshoot/oscillations around setpoint, slower settling, underdamped
// 0.5,0.1 - quicker settling, little overshoot/oscillations, overdamped
double p_gain = 0.2;
double i_gain = 0.8;

unsigned char brt = 255;  //Display Brightness

unsigned char dispbuff[1026] = { 128, 64 };  //Display Buffer to be sent to OLED

const unsigned char welcome[] PROGMEM = {
  // '5968901, 128x64px
  0x00, 0x00, 0x00, 0x00, 0x00, 0x00, 0x00, 0x00, 0x00, 0x00, 0x00, 0x00, 0x00, 0x00, 0x00, 0x00,
  0x00, 0x00, 0x00, 0x00, 0x00, 0x00, 0x00, 0x00, 0x00, 0x00, 0x00, 0x00, 0x00, 0x00, 0x00, 0x00,
  0x00, 0x00, 0x00, 0x00, 0x00, 0x00, 0x00, 0x00, 0x00, 0x00, 0x00, 0x00, 0x00, 0x00, 0x00, 0x80,
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  0x00, 0x00, 0x00, 0x00, 0x00, 0x00, 0x00, 0x00, 0x00, 0x00, 0x00, 0x00, 0x00, 0x00, 0x00, 0x00
};

const unsigned char Rbackground[] PROGMEM = {  // 128, 64,  //Right VU Meter Background
  0x00, 0x80, 0x80, 0x80, 0x00, 0x80, 0x80, 0x80, 0x00, 0x00, 0x00, 0x00,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 0x80,
  0x00, 0xCE, 0x0A, 0x0B, 0x80, 0x0F, 0x08, 0x0F, 0x00, 0x00, 0x00, 0x00,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 0x0F,
  0x80, 0xBB, 0x8A, 0x0A, 0x0B, 0x0A, 0x0A, 0x0A, 0x0A, 0x0A, 0x0A, 0x0A,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 0x00,
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  0x00, 0x00, 0x00, 0x00, 0x00, 0x00, 0x00, 0x00, 0x00, 0x00, 0x00, 0x00,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 0x00
};

const unsigned char Lbackground[] PROGMEM = {  // 128, 64,  //Left VU Meter Background
  0x00, 0x80, 0x80, 0x80, 0x00, 0x80, 0x80, 0x80, 0x00, 0x00, 0x00, 0x00,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 0x80,
  0x00, 0xCE, 0x0A, 0x0B, 0x80, 0x0F, 0x08, 0x0F, 0x00, 0x00, 0x00, 0x00,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 0x0F,
  0x80, 0xBB, 0x8A, 0x0A, 0x0B, 0x0A, 0x0A, 0x0A, 0x0A, 0x0A, 0x0A, 0x0A,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 0x00,
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  0x00, 0x00, 0x00, 0x00, 0x00, 0x00, 0x00, 0x00, 0x00, 0x00, 0x00, 0x00,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 0x00
};

const unsigned char Lspectrum[] PROGMEM = {
  // 'spectrum_test, 128x64px
  0x1f, 0x10, 0x10, 0x00, 0x1f, 0x15, 0x11, 0x00, 0x1f, 0x05, 0x01, 0x00, 0x01, 0x1f, 0x01, 0x00,
  0x00, 0x00, 0x00, 0x00, 0x00, 0x00, 0x00, 0x00, 0x00, 0x00, 0x00, 0x00, 0x00, 0x00, 0x00, 0x00,
  0x00, 0x00, 0x00, 0x00, 0x00, 0x00, 0x00, 0x00, 0x00, 0x00, 0x00, 0x00, 0x00, 0x00, 0x00, 0x00,
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  0x00, 0x00, 0x00, 0x00, 0x00, 0x00, 0xf8, 0xa8, 0xe8, 0x00, 0x88, 0xa8, 0xf8, 0x00, 0x00, 0x00
};

const unsigned char Rspectrum[] PROGMEM = {
  // 'spectrum_test_R, 128x64px
  0x00, 0x00, 0x00, 0x00, 0x00, 0x00, 0x00, 0x00, 0x00, 0x00, 0x00, 0x00, 0x00, 0x00, 0x00, 0x00,
  0x00, 0x00, 0x00, 0x00, 0x00, 0x00, 0x00, 0x00, 0x00, 0x00, 0x00, 0x00, 0x00, 0x00, 0x00, 0x00,
  0x00, 0x00, 0x00, 0x00, 0x00, 0x00, 0x00, 0x00, 0x00, 0x00, 0x00, 0x00, 0x00, 0x00, 0x00, 0x00,
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  0x00, 0x00, 0x00, 0x00, 0x10, 0xf8, 0x00, 0xf8, 0xa8, 0xe8, 0x00, 0xf8, 0x20, 0xd8, 0x00, 0x00
};

const unsigned char SmallFont[] PROGMEM = { 0x05, 0x08,                    //5x7 Small 8 bit Font
                                            0x00, 0x00, 0x00, 0x00, 0x00,  // ' '  , 480 bytes
                                            0x00, 0x00, 0x5F, 0x00, 0x00,  // !
                                            0x00, 0x07, 0x00, 0x07, 0x00,  // "
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                                            0x08, 0x1C, 0x2A, 0x08, 0x08 };  // <-

// receive event function
void receiveEvent(int howMany) {
  for (int i = 0; i < howMany; i++) {
    buffer[i] = Wire.read();  // receive byte as an integer
  }
  switch (buffer[0]) {
    case 0x01:
      for (int i = 0; i < 7; i++) {
        levelsL[i] = buffer[i + 1];
        averageValueL.push(levelsL[i]);
        //Serial.print(levelsL[i]); Serial.print(",");
      }
      break;

    case 0x02:
      for (int i = 0; i < 7; i++) {
        levelsR[i] = buffer[i + 1];
        averageValueR.push(levelsR[i]);
        //Serial.print(levelsR[i]); Serial.print(",");
      }
      break;

    default:
      for (int i = 0; i < howMany; i++) {
        Serial.print(buffer[i]);
      }
      break;
  }
  Serial.println();
  averagelevelL = averageValueL.average();
  averagelevelR = averageValueR.average();
  if ((averagelevelL + averagelevelR) == 0) {
    SLEEP = 1;  // Sleep mode detector when no audio in
  }
}

void dispRST(void) {
  delay(10);
  digitalWrite(RST, LOW);
  delay(10);
  digitalWrite(RST, HIGH);
  delay(10);
}

/*
void spi_byte(char b){	//only for bitbanged SPI implementation
  for (int i = 0; i < 8; i++) {
    //PORTD&=~(1<<CK);  //digitalWrite(CK, LOW);
    //if((b >> (7 - i) & 0b1)){PORTD|=1<<DA;}else{PORTD&=~(1<<DA);} //digitalWrite(DA, (b >> (7 - i) & 0b1));
    //PORTD|=1<<CK;  //digitalWrite(CK, HIGH);
  }
}
*/

void spi_start(bool ch) {
  if (!ch) {
    PORTD &= ~(1 << CS0);  //digitalWrite(CS0, LOW);
  } else {
    PORTD &= ~(1 << CS1);  //digitalWrite(CS1, LOW);
  }
}

void spi_end() {
  PORTD |= 1 << CS0;  //digitalWrite(CS, HIGH);
  PORTD |= 1 << CS1;
  //PORTD&=~(1<<CK);  //digitalWrite(CK, LOW);
  //PORTD&=~(1<<DA);  //digitalWrite(DA, LOW);
  PORTD &= ~(1 << DC);  //digitalWrite(DC, LOW);
}

void spi_write(bool D_C, char b, bool ch) {
  if (D_C) {
    PORTD |= 1 << DC;
  } else {
    PORTD &= ~(1 << DC);
  }  //digitalWrite(DC,D_C);
  spi_start(ch);
  //spi_byte(b);
  SPI.transfer(b);
  spi_end();
}

void disp_init(bool ch) {
  spi_write(CMD, 0xAE, ch);  //Set display off
  spi_write(CMD, 0xD5, ch);  //Set display clock divide ratio
  spi_write(CMD, 0x80, ch);  //Set display oscillator freq
  spi_write(CMD, 0xA8, ch);  //Set multiplex ratio
  spi_write(CMD, 0x3F, ch);
  spi_write(CMD, 0xD3, ch);  //Set display offset
  spi_write(CMD, 0x00, ch);
  spi_write(CMD, 0x40, ch);  //Set display start line
  //spi_write(CMD,0x8D,ch); //Set charge pump
  //spi_write(CMD,0x14,ch);
  spi_write(CMD, 0xA1, ch);  //Set segment remap
  spi_write(CMD, 0xC8, ch);  //Set com output scan dir
  spi_write(CMD, 0xDA, ch);  //Set com pins hardware config
  spi_write(CMD, 0x12, ch);
  spi_write(CMD, 0x81, ch);  //Set contrast control
  spi_write(CMD, 0xCF, ch);
  spi_write(CMD, 0xD9, ch);  //Set precharge period
  spi_write(CMD, 0xF1, ch);
  spi_write(CMD, 0xDB, ch);  //Set vcomh deselect level
  spi_write(CMD, 0x40, ch);
  spi_write(CMD, 0xA4, ch);  //Set entire display on/off
  spi_write(CMD, 0xA6, ch);  //Set normal/inverse display
  spi_write(CMD, 0x20, ch);  //Set memory addressing mode
  spi_write(CMD, 0x00, ch);
  spi_write(CMD, 0xAF, ch);  //Set display on
}

void brightness(unsigned char b) {
  for (int i = 0; i < 2; i++) {
    spi_write(CMD, 0x81, i);  //Set contrast control
    spi_write(CMD, b, i);
  }
}

void printchar(char c, int font, bool inv, bool ch) {
  unsigned char w, h = 0;
  w = pgm_read_byte_near(font);
  h = pgm_read_byte_near(font + 1);
  for (int i = 0; i < 5; i++) {
    spi_write(DATA, pgm_read_byte_near(font + 2 + (w * h / 8) * (c - 32) + i), ch);
  }
  spi_write(DATA, 0x00, ch);
}

void writeString(String str, bool ch) {
  unsigned char len = str.length();
  unsigned char p = 0;
  while (p < len) {
    printchar(str.charAt(p), SmallFont, NORM, ch);
    p++;
  }
}

void clr(bool ch) {
  if (disp_type == SSD1306 || disp_type == SSD1309) {
    for (int i = 0; i < 8192; i++) {
      spi_write(DATA, 0x00, ch);
    }
  } else {
    for (int j = 0; j < 8; j++) {
      set_xy(0, j, ch);
      for (int i = 0; i < 128; i++) {
        spi_write(DATA, 0x00, ch);
      }
    }
  }
  set_xy(0, 0, ch);
}

void set_xy(char x, char y, bool ch) {
  if (disp_type == SSD1306 || disp_type == SSD1309) {
    spi_write(CMD, 0x21, ch);  //set x
    spi_write(CMD, 0x00 + x, ch);
    spi_write(CMD, 0x7F, ch);
    spi_write(CMD, 0xB0 + y, ch);  //set y
  } else {
    x += 2;
    spi_write(CMD, 0xB0 | y, ch);  //set y
    //spi_write(CMD,y);
    spi_write(CMD, x & 0x0F, ch);  //set x
    spi_write(CMD, ((x >> 4) & 0x0F) | 0x10, ch);
  }
}

void drawBMP(int x, int y, unsigned long bmp, unsigned char elem, bool inv, bool ch) {  //write bitmap image to location X,Y on screen, can specify array bmp and elem index of image
  unsigned char w = *(char*)bmp;                                                        //must cast to obtain value in ram given the address
  unsigned char h = *(char*)(bmp + 1);

  for (int j = 0; j < h / 8; j++) {
    set_xy(x, y + j, ch);
    for (int i = 0; i < w; i++) {
      //writeI2C(OLEDaddr,DAT,0,(*(char*)(bmp+2+j*w+i+w*(h/8)*elem))^(inv*0xFF),0);
      spi_write(DATA, (*(char*)(bmp + 2 + j * w + i + w * (h / 8) * elem)) ^ (inv * 0xFF), ch);
    }
  }
}

void drawline(uint8_t x0, uint8_t y0, uint8_t x1, uint8_t y1, bool ch) {
  if (abs(y1 - y0) < abs(x1 - x0)) {
    if (x0 > x1) {
      plotLineLow(x1, y1, x0, y0);
    } else {
      plotLineLow(x0, y0, x1, y1);
    }
  } else {
    if (y0 > y1) {
      plotLineHigh(x1, y1, x0, y0);
    } else {
      plotLineHigh(x0, y0, x1, y1);
    }
  }
  drawBMP(0, 0, dispbuff, 0, NORM, ch);
}

void drawlineNoBuff(uint8_t x0, uint8_t y0, uint8_t x1, uint8_t y1, bool ch) {
  if (abs(y1 - y0) < abs(x1 - x0)) {
    if (x0 > x1) {
      plotLineLow(x1, y1, x0, y0);
    } else {
      plotLineLow(x0, y0, x1, y1);
    }
  } else {
    if (y0 > y1) {
      plotLineHigh(x1, y1, x0, y0);
    } else {
      plotLineHigh(x0, y0, x1, y1);
    }
  }
}

void drawboxNoBuff(uint8_t x0, uint8_t y0, uint8_t x1, uint8_t y1, bool ch) {
  if (abs(y1 - y0) < abs(x1 - x0)) {
    if (x0 > x1) {
      plotLineLow(x1, y1, x0, y0);
    } else {
      plotLineLow(x0, y0, x1, y1);
    }
  } else {
    if (y0 > y1) {
      plotLineHigh(x1, y1, x0, y0);
    } else {
      plotLineHigh(x0, y0, x1, y1);
    }
  }
}

void plotLineLow(uint8_t x0, uint8_t y0, uint8_t x1, uint8_t y1) {
  char dx = x1 - x0;
  char dy = y1 - y0;
  char yi = 1;
  if (dy < 0) {
    yi = -1;
    dy = -dy;
  }
  char d = (2 * dy) - dx;
  char y = y0;
  for (int x = x0; x <= x1; x++) {
    dispbuff[2 + x + 128 * (y / 8)] |= 1 << (y % 8);
    if (d > 0) {
      y = y + yi;
      d = d + (2 * (dy - dx));
    } else {
      d = d + 2 * dy;
    }
  }
}

void plotLineHigh(uint8_t x0, uint8_t y0, uint8_t x1, uint8_t y1) {
  char dx = x1 - x0;
  char dy = y1 - y0;
  char xi = 1;
  if (dx < 0) {
    xi = -1;
    dx = -dx;
  }
  char d = (2 * dx) - dy;
  char x = x0;
  for (int y = y0; y <= y1; y++) {
    dispbuff[2 + x + 128 * (y / 8)] |= 1 << (y % 8);
    if (d > 0) {
      x = x + xi;
      d = d + (2 * (dx - dy));
    } else {
      d = d + 2 * dx;
    }
  }
}

void vumeter() {

  //Vumeter
  val0 = map(averagelevelL, 0, 255, 0, 127);  //Grab Digital Input Measurement (scaled to 0-127)
  val1 = map(averagelevelR, 0, 255, 0, 127);  //Grab Digital Input Measurement (scaled to 0-127)

  if (PHYS) {
    if (PHYS == 1) {
      p_gain = 0.2;
      i_gain = 0.8;
    }  //Set gain values for current mode
    if (PHYS == 2) {
      p_gain = 0.5;
      i_gain = 0.1;
    }

    err0 = val0 - pos0;  //Calculate Error
    err1 = val1 - pos1;

    err_accum0 += i_gain * err0;  //Calculate PI
    pos0 += (int)(p_gain * err0 + err_accum0);

    err_accum1 += i_gain * err1;
    pos1 += (int)(p_gain * err1 + err_accum1);

    if (pos0 > 127) { pos0 = 127; }  //max min limiter
    if (pos0 < 0) { pos0 = 0; }
    if (pos1 > 127) { pos1 = 127; }
    if (pos1 < 0) { pos1 = 0; }
  } else {
    pos0 = val0;
    pos1 = val1;
  }

  for (int i = 0; i < 1024; i++) {  //transfer background stored in flash to ram display buffer
    dispbuff[i + 2] = pgm_read_byte_near(Lbackground + i);
  }
  drawline(71 - (127 - pos0) / 8, 63, pos0, 20 - (int)(((double)(pos0 * (127 - pos0))) / 200), Disp0);  //draw line over background

  for (int i = 0; i < 1024; i++) {  //transfer background stored in flash to ram display buffer
    dispbuff[i + 2] = pgm_read_byte_near(Rbackground + i);
  }
  drawline(71 - (127 - pos1) / 8, 63, pos1, 20 - (int)(((double)(pos1 * (127 - pos1))) / 200), Disp1);
}

void spectrumbars() {

  for (int i = 0; i < 1024; i++) {  //transfer background stored in flash to ram display buffer
    dispbuff[i + 2] = pgm_read_byte_near(Lspectrum + i);
  }

  for (int i = 0; i < 7; i++) {
    audio_bar_heightL[i] = audio_bar_heightL[i] + ((map((levelsL[i]), 0, 255, 0, 53) - audio_bar_heightL[i]));  // update the bar with a new value (slowly)
    // calculate the peak position
    if (audio_bar_peakL[i] < audio_bar_heightL[i]) {         // if the peak is below the current bar size
      audio_bar_peakL[i] = audio_bar_heightL[i];             // move peak to the new max. position (i.e. size of the bar)
    } else if (audio_bar_peakL[i] > audio_bar_heightL[i]) {  // if the bar is lower than the peak
      audio_bar_peakL[i]--;                                  // slowly move the peak down, one pixel every frame
    }

    audio_bar_heightR[i] = audio_bar_heightR[i] + ((map((levelsR[i]), 0, 255, 0, 53) - audio_bar_heightR[i]));  // update the bar with a new value (slowly)
    // calculate the peak position
    if (audio_bar_peakR[i] < audio_bar_heightR[i]) {         // if the peak is below the current bar size
      audio_bar_peakR[i] = audio_bar_heightR[i];             // move peak to the new max. position (i.e. size of the bar)
    } else if (audio_bar_peakR[i] > audio_bar_heightR[i]) {  // if the bar is lower than the peak
      audio_bar_peakR[i]--;                                  // slowly move the peak down, one pixel every frame
    }
  }

  // Roll over different screens
  for (int i = 0; i < 7; i++) {
    if (SBT == 0) {
      for (int j = 2; j < 12; j++) {
        drawlineNoBuff(j + (i * 19), 53, j + (i * 19), 53 - audio_bar_heightL[i], Disp0);
      }
      drawlineNoBuff(2 + i * 19, 53 - audio_bar_peakL[i], 11 + i * 19, 53 - audio_bar_peakL[i], Disp0);
    } else {
      drawlineNoBuff(2 + i * 19, 53 - audio_bar_heightL[i], 11 + i * 19, 53 - audio_bar_heightL[i], Disp0);
      drawlineNoBuff(2 + (i * 19), 53, 2 + (i * 19), 53 - audio_bar_heightL[i], Disp0);
      drawlineNoBuff(11 + (i * 19), 53, 11 + (i * 19), 53 - audio_bar_heightL[i], Disp0);
    }
  }

  //Send buffer
  drawBMP(0, 0, dispbuff, 0, NORM, Disp0);

  for (int i = 0; i < 1024; i++) {  //transfer background stored in flash to ram display buffer
    dispbuff[i + 2] = pgm_read_byte_near(Rspectrum + i);
  }

  for (int i = 0; i < 7; i++) {
    if (SBT == 0) {
      for (int j = 2; j < 12; j++) {
        drawlineNoBuff(j + (i * 19), 53, j + (i * 19), 53 - audio_bar_heightR[i], Disp0);
      }
      drawlineNoBuff(2 + i * 19, 53 - audio_bar_peakR[i], 11 + i * 19, 53 - audio_bar_peakR[i], Disp1);
    } else {
      drawlineNoBuff(2 + i * 19, 53 - audio_bar_heightR[i], 11 + i * 19, 53 - audio_bar_heightR[i], Disp1);
      drawlineNoBuff(2 + (i * 19), 53, 2 + (i * 19), 53 - audio_bar_heightR[i], Disp1);
      drawlineNoBuff(11 + (i * 19), 53, 11 + (i * 19), 53 - audio_bar_heightR[i], Disp1);
    }
  }

  //Send buffer
  drawBMP(0, 0, dispbuff, 0, NORM, Disp1);
}

void buttonsUpdate() {
}

void setup() {

  pinMode(BTN, INPUT_PULLUP);
  pinMode(BTNM, INPUT_PULLUP);
  pinMode(Plus, INPUT_PULLUP);
  pinMode(Minus, INPUT_PULLUP);
  Serial.begin(115200);
  SPI.begin();
  SPI.beginTransaction(SPISettings(4000000, MSBFIRST, SPI_MODE0));
  Wire.begin(i2c_addr);          // join i2c bus with address i2c_addr
  Wire.onReceive(receiveEvent);  // register event

  pinMode(RST, OUTPUT);
  pinMode(DC, OUTPUT);
  pinMode(CS0, OUTPUT);
  pinMode(CS1, OUTPUT);
  //pinMode(CK,OUTPUT);
  //pinMode(DA,OUTPUT);
  digitalWrite(CS0, HIGH);
  digitalWrite(CS1, HIGH);
  digitalWrite(RST, HIGH);

  PHYS = EEPROM.read(0);  // Reload last saved PHYSICS
  if (PHYS > 2) {
    PHYS = 0;
    EEPROM.update(0, PHYS);
  }
  brt = EEPROM.read(1);
  brightness(256 - brt);  // Reload last saved brightness
  SCR = EEPROM.read(2);   // Reload last saved screen
  SBT = EEPROM.read(3);   // Reload last Spectrum bars type
  dispRST();
  disp_init(Disp0);
  disp_init(Disp1);
  clr(Disp0);
  clr(Disp1);
  //set_xy(30, 3, Disp0);
  //set_xy(30, 3, Disp1);
  //writeString("VU Meter", Disp0);
  //writeString("Version 1.0", Disp1);
  //set_xy(30, 4, Disp0);
  //set_xy(30, 4, Disp1);
  //writeString("mlc76520", Disp0);
  //writeString("C 31/12/24", Disp1);
  for (int i = 0; i < 1024; i++) {  //transfer background stored in flash to ram display buffer
    dispbuff[i + 2] = pgm_read_byte_near(welcome + i);
  }
  drawBMP(0, 0, dispbuff, 0, NORM, Disp0);
  drawBMP(0, 0, dispbuff, 0, NORM, Disp1);

  delay(1000);
  clr(Disp0);
  clr(Disp1);
}

void loop() {
  //buttons

  if (digitalRead(Plus) == 0) {
    if (brt > 1) {
      brt--;
      EEPROM.update(1, brt);
      brightness(256 - brt);
    }
    char buff[3];
    set_xy(0, 7, Disp0);
    writeString(itoa(256 - brt, buff, 10), Disp0);
    delay(100);
  }

  if (digitalRead(Minus) == 0) {
    if (brt < 255) {
      brt++;
      EEPROM.update(1, brt);
      brightness(256 - brt);
    }
    char buff[3];
    set_xy(0, 7, Disp0);
    writeString(itoa(256 - brt, buff, 10), Disp0);
    delay(100);
  }

  if (digitalRead(BTNM) == 0) {
    SCR = !SCR;
    EEPROM.update(2, SCR);
    delay(1000);
    while (digitalRead(BTN) == 0) { ; }
  }

  switch (SCR) {  // Rolling around different screens
    // Spectrum
    case 0:
      spectrumbars();
      // spectrumbars button bars type
      if (digitalRead(BTN) == 0) {
        SBT = !SBT;
        EEPROM.update(3, SBT);
        delay(1000);
        while (digitalRead(BTN) == 0) { ; }
      }
      break;
    case 1:
      SCR = 1;
      vumeter();
      // Vumeter button phys
      if (digitalRead(BTN) == 0) {
        if (PHYS < 2) {
          PHYS++;
        } else {
          PHYS = 0;
        }
        EEPROM.update(0, PHYS);
        set_xy(0, 7, Disp1);
        if (PHYS == 1) {
          writeString("U", Disp1);
        } else if (PHYS == 2) {
          writeString("O", Disp1);
        } else {
          writeString("N", Disp1);
        }
        delay(1000);
        while (digitalRead(BTN) == 0) { ; }
      }
      break;
  }


  /* if ((SLEEP)==1){
    for (int i = 0; i < 1024; i++) {  //transfer background stored in flash to ram display buffer
      dispbuff[i+2] =  0;
    }
    drawBMP(0, 0, dispbuff, 0, NORM, Disp0);
    drawBMP(0, 0, dispbuff, 0, NORM, Disp1);
  } */
}